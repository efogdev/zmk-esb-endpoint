## dts/bindings/behaviors/zmk,behavior-esb-goto.yaml
```yaml
# Copyright (c) 2025 efogdev
# SPDX-License-Identifier: MIT

description: ESB GO-TO behavior

compatible: "zmk,behavior-esb-goto"

include: zero_param.yaml
```

## dts/bindings/behaviors/zmk,behavior-esb-shell-req.yaml
```yaml
# Copyright (c) 2025 efogdev
# SPDX-License-Identifier: MIT

description: ESB shell relay request behavior

compatible: "zmk,behavior-esb-shell-req"

include: zero_param.yaml
```

## dts/bindings/behaviors/zmk,behavior-esb-unpair.yaml
```yaml
# Copyright (c) 2025 efogdev
# SPDX-License-Identifier: MIT

description: ESB unpair behavior

compatible: "zmk,behavior-esb-unpair"

include: zero_param.yaml
```

## dts/bindings/input_processors/zmk,esb-input-processor.yaml
```yaml
# Copyright (c) 2025 efogdev
# SPDX-License-Identifier: MIT

description: Input processor that forwards pointer/mouse events over ESB when active
compatible: "zmk,esb-input-processor"
include: ip_zero_param.yaml
```

## dts/bindings/zmk,esb-endpoint.yaml
```yaml
# Copyright (c) 2025 efogdev
# SPDX-License-Identifier: MIT

description: ZMK ESB endpoint configuration node
compatible: "zmk,esb-endpoint"

properties:
  esb-channel:
    type: int
    required: true
    description: RF channel number (0-100). Channel N = 2400+N MHz.
  pairing-base-address:
    type: uint8-array
    required: true
    description: 4-byte base address for the pairing pipe (pipe 0).
  pairing-prefix:
    type: int
    required: true
    description: 1-byte address prefix for the pairing pipe (pipe 0).
  data-base-address:
    type: uint8-array
    required: true
    description: 4-byte base address for the HID data pipe (pipe 1).
  data-prefix:
    type: int
    required: true
    description: 1-byte address prefix for the HID data pipe (pipe 1).
```

## src/behaviors/Kconfig
```kconfig
config ZMK_ESB_BEHAVIOR_UNPAIR
    bool "ESB unpair behavior"
    depends on ZMK_ESB_ENDPOINT
    default y

config ZMK_ESB_BEHAVIOR_SHELL_REQ
    bool "ESB shell-session request behavior"
    depends on ZMK_ESB_ENDPOINT_SHELL_RELAY
    default y
    help
      Adds a keymap behavior (&esb_shell_req) that asks the dongle to open
      a shell relay session over USB CDC — equivalent to a short press on
      the dongle's pair button while paired.
```

## src/shell/Kconfig
```kconfig
config ZMK_ESB_ENDPOINT_SHELL_RELAY
    bool "ESB shell relay (execute commands forwarded from dongle)"
    depends on SHELL
    select ZMK_SHELL_RELAY_CORE
    default n
    help
      When the dongle requests a shell session (single button press while
      paired), accepts shell commands via ESB and returns output over ESB.
      Commands are executed using the Zephyr dummy shell backend.
      The session ends automatically after SHELL_INACTIVITY_S of no input.

config ZMK_ESB_ENDPOINT_SHELL_POLL_INTERVAL_MS
    int "Shell poll interval (ms)"
    default 20
    range 5 500
    depends on ZMK_ESB_ENDPOINT_SHELL_RELAY
    help
      How often the keyboard sends SHELL_POLL packets to solicit queued
      user input from the dongle when no HID events are occurring.

config ZMK_ESB_ENDPOINT_SHELL_INACTIVITY_S
    int "Shell inactivity timeout (seconds)"
    default 60
    range 0 3600
    depends on ZMK_ESB_ENDPOINT_SHELL_RELAY
    help
      If no command bytes arrive within this period, the keyboard sends
      SHELL_STOP and exits shell relay mode.

config ZMK_ESB_ENDPOINT_SHELL_CMD_BUF_SIZE
    int "Shell command buffer size (bytes)"
    default 256
    depends on ZMK_ESB_ENDPOINT_SHELL_RELAY

config ZMK_ESB_ENDPOINT_SHELL_DRAIN_RETRY_MS
    int "Shell output drain retry interval (ms)"
    default 5
    range 1 100
    depends on ZMK_ESB_ENDPOINT_SHELL_RELAY

config ZMK_ESB_ENDPOINT_SHELL_STDOUT_COALESCE_BYTES
    int "stdout hook coalescing buffer size (bytes)"
    default 96
    range 16 256
    depends on ZMK_ESB_ENDPOINT_SHELL_RELAY
    help
      printk/puts emit one byte at a time through the stdout hook.
      Without coalescing every byte triggers out_enqueue + out_drain_work,
      producing one tiny ESB packet per byte. The hook accumulates bytes
      and flushes when this buffer fills or after STDOUT_COALESCE_MS of
      no further hook activity.

config ZMK_ESB_ENDPOINT_SHELL_STDOUT_COALESCE_MS
    int "stdout hook coalescing idle flush (ms)"
    default 5
    range 1 100
    depends on ZMK_ESB_ENDPOINT_SHELL_RELAY
    help
      Flush the stdout coalescing buffer after this many milliseconds of
      no further bytes from the stdout hook.

config ZMK_ESB_ENDPOINT_SHELL_LOG_LINE_BUF_SIZE
    int "Per-message log staging buffer size (bytes)"
    default 96
    range 32 512
    depends on ZMK_ESB_ENDPOINT_SHELL_RELAY
    help
      Size of the staging buffer LOG_OUTPUT_DEFINE hands to the ESB log
      backend's output function. A formatted log message larger than
      this is fragmented into multiple out_enqueue calls. Larger values
      keep long log lines contiguous at the cost of more permanent RAM.

config ZMK_ESB_ENDPOINT_SHELL_PROMPT
    string "Shell prompt string"
    default SHELL_PROMPT_UART
    depends on ZMK_ESB_ENDPOINT_SHELL_RELAY

config ZMK_ESB_ENDPOINT_SHELL_BG_POLL
    bool "Send SHELL_BG_POLL keepalives while shell is idle"
    default y
    depends on ZMK_ESB_ENDPOINT_SHELL_RELAY
    help
      When paired but no shell session is active, send periodic
      SHELL_BG_POLL packets to keep the ACK pipeline open so a dongle
      SHELL_REQ is delivered promptly. Disable to avoid any idle-time
      ESB TX; the dongle will then only reach the keyboard via ACKs on
      HID or other ESB traffic the keyboard initiates.

config ZMK_ESB_ENDPOINT_SHELL_BG_POLL_MS
    int "Background ACK poll interval while shell is idle (ms)"
    default 100
    range 100 5000
    depends on ZMK_ESB_ENDPOINT_SHELL_BG_POLL
    help
      How often SHELL_BG_POLL is sent while paired and no shell session
      is active.

config ZMK_ESB_ENDPOINT_SHELL_BG_POLL_ACTIVITY_THRESHOLD_MS
    int "Background ACK poll activity threshold (ms)"
    default 5000
    range 0 3600000
    depends on ZMK_ESB_ENDPOINT_SHELL_BG_POLL
    help
      Gate the background poll on recent ESB traffic: if no non-bg-poll ESB
      TX or RX has occurred within this many milliseconds, the periodic
      SHELL_BG_POLL is suppressed. The work keeps rescheduling so polling
      resumes automatically on the next TX/RX. Set to 0 to disable gating
      (always poll while paired).

config ZMK_ESB_ENDPOINT_SHELL_INITIAL_POLL_DELAY_MS
    int "Initial shell poll delay after SHELL_REQ received (ms)"
    default 20
    range 5 500
    depends on ZMK_ESB_ENDPOINT_SHELL_RELAY

config ZMK_ESB_ENDPOINT_SHELL_STOP_NUDGE_COOLDOWN_MS
    int "SHELL_STOP nudge cooldown (ms)"
    default 5000
    range 50 60000
    depends on ZMK_ESB_ENDPOINT_SHELL_RELAY
    help
      Minimum interval between SHELL_STOP nudges sent to the dongle when
      SHELL_DATA arrives but the keyboard has no active session. Debounces
      a burst of in-flight payloads following an unexpected dongle state.
```
